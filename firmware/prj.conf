## CMakeLists.txt
```
cmake_minimum_required(VERSION 3.20.0)
find_package(Zephyr REQUIRED HINTS $ENV{ZEPHYR_BASE})

project(epaper_dashboard)

target_sources(app PRIVATE
  src/main.c
  src/wifi.c
  src/ntp.c
  src/http_fetch.c
  src/png_decode.c
  src/epaper.c
  src/schedule.c
  src/button.c
  src/nvs_store.c
  src/screensaver.c
  src/boot_log.c
  lib/pngle/pngle.c
  lib/pngle/miniz.c
)

target_include_directories(app PRIVATE src lib/pngle)
```

## west.yml
```
manifest:
  remotes:
    - name: zephyrproject-rtos
      url-base: https://github.com/zephyrproject-rtos

  projects:
    - name: zephyr
      remote: zephyrproject-rtos
      revision: v3.7.0
      import: true

  self:
    path: epaper_dashboard
```

## prj.conf
```kconfig
CONFIG_NETWORKING=y
CONFIG_NET_IPV4=y
CONFIG_NET_TCP=y
CONFIG_DNS_RESOLVER=y
CONFIG_NET_SOCKETS=y
CONFIG_HTTP_CLIENT=y
CONFIG_SNTP=y
CONFIG_WIFI=y
CONFIG_NET_L2_WIFI_MGMT=y
CONFIG_NET_DHCPV4=y
CONFIG_DISPLAY=y
CONFIG_SETTINGS=y
CONFIG_SETTINGS_NVS=y
CONFIG_NVS=y
CONFIG_FLASH=y
CONFIG_FLASH_MAP=y
CONFIG_GPIO=y
CONFIG_RTC=y
CONFIG_LOG=y
CONFIG_LOG_DEFAULT_LEVEL=3
CONFIG_LOG_BUFFER_SIZE=8192
CONFIG_MAIN_STACK_SIZE=8192
CONFIG_SYSTEM_WORKQUEUE_STACK_SIZE=4096
CONFIG_HEAP_MEM_POOL_SIZE=65536
# PSRAM — ESP32-S3-R8 has 8 MB Octal PSRAM
CONFIG_ESP_SPIRAM=y
CONFIG_SPIRAM_MODE_OCT=y
# sys_poweroff() triggers ESP32 deep sleep
CONFIG_POWEROFF=y
CONFIG_REBOOT=y
# Hardware watchdog — resets the SoC if a boot cycle hangs and never reaches
# sys_poweroff() (e.g. an unresponsive ePaper BUSY line or a stuck socket call).
CONFIG_WATCHDOG=y
```

## app.overlay
```dts
/*
 * Mark gpio0 as a wakeup-source device so the Zephyr ESP32 GPIO driver
 * will call esp_sleep_enable_ext1_wakeup_io() for any pin configured with
 * GPIO_INT_TRIG_WAKE_LOW, enabling GPIO wakeup from deep sleep.
 */
&gpio0 {
	wakeup-source;
};
```

## src/main.c
```c
/*
 * main.c — ePaper Dashboard Firmware, Stage 2
 *
 * Boot sequence (runs once; ends in sys_poweroff / deep sleep):
 *   Init → detect wakeup source → load NVS → Wi-Fi → NTP →
 *   schedule mode dispatch → sleep
 *
 * Deep sleep on ESP32-S3 is a full chip reset. All state that must
 * survive sleep is persisted in NVS (settings subsystem).
 */
#include <zephyr/kernel.h>
#include <zephyr/device.h>
#include <zephyr/devicetree.h>
#include <zephyr/drivers/watchdog.h>
#include <zephyr/logging/log.h>
#include <zephyr/random/random.h>
#include <zephyr/sys/poweroff.h>
#include <esp_sleep.h>
#include <stdio.h>
#include <string.h>

#include "config.h"
#include "wifi.h"
#include "ntp.h"
#include "http_fetch.h"
#include "png_decode.h"
#include "epaper.h"
#include "schedule.h"
#include "button.h"
#include "nvs_store.h"
#include "screensaver.h"
#include "boot_log.h"

LOG_MODULE_REGISTER(main, LOG_LEVEL_INF);

/* Large buffers live in 8 MB PSRAM, not internal DRAM */
#define EXT_RAM __attribute__((section(".ext_ram.bss")))

static EXT_RAM uint8_t png_buf[PNG_BUF_SIZE];
static EXT_RAM uint8_t fb_dtm1[FB_PLANE_SIZE];
static EXT_RAM uint8_t fb_dtm2[FB_PLANE_SIZE];

/* File-scope state loaded from NVS at boot */
static char    stored_etag[64];
static uint8_t buf_index;
static uint8_t partial_count;
static uint8_t ss_last;  /* non-zero when previous display was a screensaver */

/* Watchdog — final backstop against any hang (BUSY stuck, a stuck socket
 * call, etc.) that would otherwise leave the device frozen until someone
 * notices and power-cycles it. 5 minutes is far beyond any single phase's
 * own bounded timeout, so it only fires on a genuine hang; on fire it
 * resets the SoC, which is equivalent to the manual power-cycle that
 * currently clears the freeze. Fed at each phase boundary below. */
#define WDT_TIMEOUT_MS 300000

static const struct device *wdt_dev;
static int wdt_channel_id = -1;

static void watchdog_start(void)
{
	wdt_dev = DEVICE_DT_GET(DT_ALIAS(watchdog0));
	if (!device_is_ready(wdt_dev)) {
		LOG_WRN("Watchdog device not ready — hangs will not auto-recover");
		wdt_dev = NULL;
		return;
	}

	struct wdt_timeout_cfg wdt_config = {
		.flags      = WDT_FLAG_RESET_SOC,
		.window.min = 0,
		.window.max = WDT_TIMEOUT_MS,
	};

	wdt_channel_id = wdt_install_timeout(wdt_dev, &wdt_config);
	if (wdt_channel_id < 0 || wdt_setup(wdt_dev, 0) < 0) {
		LOG_WRN("Watchdog setup failed — hangs will not auto-recover");
		wdt_dev = NULL;
	}
}

static void watchdog_feed(void)
{
	if (wdt_dev) {
		wdt_feed(wdt_dev, wdt_channel_id);
	}
}

static void enter_deep_sleep(int sleep_s)
{
	epaper_power_off();
	LOG_INF("Deep sleep %d s", sleep_s);
	esp_sleep_enable_timer_wakeup((uint64_t)sleep_s * 1000000ULL);
	sys_poweroff();
}

static void do_fetch_and_display(const char *path, const char *etag_in,
                                  bool force_full)
{
	/* Exiting screensaver: force a full refresh to clear any ghosting. */
	if (ss_last) {
		force_full = true;
		partial_count = 0;
		nvs_store_partial_count_set(0);
		ss_last = 0;
		nvs_store_ss_last_set(0);
	}

	size_t bytes = 0;
	char new_etag[64] = "";

	int ret = http_fetch(path, etag_in, png_buf, PNG_BUF_SIZE, &bytes, new_etag);

	if (ret == HTTP_FETCH_NOT_MODIFIED) {
		LOG_INF("304 Not Modified — skipping refresh");
		return;
	}
	if (ret == HTTP_FETCH_NOT_FOUND) {
		LOG_WRN("404 for %s — buffer index reset to 0", path);
		buf_index = 0;
		nvs_store_buf_index_set(0);
		/* Retry with main display path */
		ret = http_fetch("/display.png", etag_in, png_buf, PNG_BUF_SIZE,
		                 &bytes, new_etag);
		if (ret != HTTP_FETCH_OK || bytes == 0) {
			LOG_ERR("Fallback fetch also failed");
			return;
		}
	}
	if (ret != HTTP_FETCH_OK || bytes == 0) {
		LOG_ERR("Fetch failed for %s (ret=%d)", path, ret);
		return;
	}

	if (png_decode_4gray(png_buf, bytes, fb_dtm1, fb_dtm2,
	                     DISPLAY_WIDTH, DISPLAY_HEIGHT) != 0) {
		LOG_ERR("PNG decode failed");
		return;
	}

	if (new_etag[0]) {
		strncpy(stored_etag, new_etag, sizeof(stored_etag) - 1);
		stored_etag[sizeof(stored_etag) - 1] = '\0';
		nvs_store_etag_set(stored_etag);
	}

	bool do_full = force_full || (partial_count >= MAX_PARTIAL_BEFORE_FULL);

	epaper_4gray_refresh(fb_dtm1, fb_dtm2, FB_PLANE_SIZE);

	if (do_full) {
		partial_count = 0;
	} else {
		partial_count++;
	}
	nvs_store_partial_count_set(partial_count);
}

int main(void)
{
	LOG_INF("ePaper Dashboard starting (Stage 2)");

	/* ── Phase 1: Hardware init ─────────────────────────────── */
	nvs_store_init();
	watchdog_start();
	boot_log_init();
	boot_log_dump();

	if (epaper_init() != 0 || epaper_4gray_init() != 0) {
		LOG_ERR("ePaper init failed — sleeping %d s", POLL_INTERVAL_INACTIVE_S);
		esp_sleep_enable_timer_wakeup(
			(uint64_t)POLL_INTERVAL_INACTIVE_S * 1000000ULL);
		sys_poweroff();
		return 0;
	}
	watchdog_feed();

	/* button_init() calls esp_sleep_enable_ext1_wakeup() directly */
	button_init();

	/* ── Phase 2: Wakeup source detection ──────────────────── */
	button_mask_t wakeup = button_get_wakeup_source();
	bool green_wake = (wakeup & BUTTON_GREEN) != 0;
	bool left_wake  = (wakeup & BUTTON_LEFT)  != 0;
	bool right_wake = (wakeup & BUTTON_RIGHT) != 0;
	bool btn_wake   = (wakeup != BUTTON_NONE);

	LOG_INF("Wakeup: green=%d left=%d right=%d timer=%d",
	        green_wake, left_wake, right_wake, !btn_wake);

	/* ── Phase 3: Load persisted state ──────────────────────── */
	nvs_store_etag_get(stored_etag, sizeof(stored_etag));
	nvs_store_buf_index_get(&buf_index);
	nvs_store_partial_count_get(&partial_count);
	nvs_store_ss_last_get(&ss_last);

	/* ── Phase 4: Wi-Fi ─────────────────────────────────────── */
	LOG_INF("Connecting to Wi-Fi \"%s\"", WIFI_SSID);
	if (wifi_connect() != 0) {
		epaper_show_error(
			"Wi-Fi connection failed\n"
			"Could not connect to: " WIFI_SSID "\n"
			"Retrying in 5 minutes."
		);
		enter_deep_sleep(300);
		return 0;
	}
	watchdog_feed();

	/* ── Phase 5: Time sync ──────────────────────────────────── */
	ntp_sync();
	watchdog_feed();
	struct tm now = ntp_get_local_time();
	schedule_mode_t mode = schedule_get_mode(&now);

	/* ── Phase 6: Mode dispatch ──────────────────────────────── */
	if (mode == MODE_INACTIVE) {

		if (btn_wake) {
			/* Show the requested display, then deep sleep 60 s so the
			 * user can read it.  The next timer wake will show a
			 * screensaver and sleep until the next scheduled event. */
			char path[32];
			if (left_wake || right_wake) {
				if (left_wake && buf_index > 0) buf_index--;
				else if (right_wake) buf_index++;
				nvs_store_buf_index_set(buf_index);
				snprintf(path, sizeof(path), "/display/%u",
				         (unsigned)buf_index);
			} else {
				strncpy(path, "/display.png", sizeof(path));
			}
			nvs_store_etag_set("");
			stored_etag[0] = '\0';
			partial_count = 0;
			nvs_store_partial_count_set(0);
			do_fetch_and_display(path, NULL, true);
			watchdog_feed();

			enter_deep_sleep(60);
			return 0;
		}

		/* Timer wake (including the 60 s wake after a button press):
		 * show one screensaver image, then fall through to sleep until
		 * the next scheduled event. */
		partial_count = 0;
		nvs_store_partial_count_set(0);
		screensaver_show_one((int)sys_rand32_get(), png_buf, PNG_BUF_SIZE,
		                     fb_dtm1, fb_dtm2, FB_PLANE_SIZE);
		watchdog_feed();
		ss_last = 1;
		nvs_store_ss_last_set(1);

	} else if (mode == MODE_NTP_SYNC_ONLY) {

		/* 00:00 NTP sync: clock already updated in Phase 5, no display action */
		LOG_INF("NTP sync only — skipping display update");

	} else { /* MODE_ACTIVE_WINDOW */

		char path[32];

		if (green_wake) {
			/* Force full refresh, ignore stored ETag */
			partial_count = 0;
			nvs_store_partial_count_set(0);
			nvs_store_etag_set("");
			stored_etag[0] = '\0';
			do_fetch_and_display("/display.png", NULL, true);
			watchdog_feed();

		} else if (left_wake || right_wake) {
			/* Cycle display buffer */
			if (left_wake && buf_index > 0) {
				buf_index--;
			} else if (right_wake) {
				buf_index++;
			}
			nvs_store_buf_index_set(buf_index);
			nvs_store_etag_set("");
			stored_etag[0] = '\0';
			snprintf(path, sizeof(path), "/display/%u", (unsigned)buf_index);
			do_fetch_and_display(path, NULL, true);
			watchdog_feed();

		} else {
			/* Normal poll — use ETag to skip unchanged display */
			do_fetch_and_display("/display.png", stored_etag, false);
			watchdog_feed();
		}
	}

	/* ── Phase 7: Sleep ─────────────────────────────────────── */
	int sleep_s;
	if (mode == MODE_ACTIVE_WINDOW) {
		sleep_s = POLL_INTERVAL_ACTIVE_S;
	} else {
		sleep_s = schedule_sleep_seconds(&now);
		if (sleep_s <= 0) {
			sleep_s = POLL_INTERVAL_INACTIVE_S;
		}
	}

	LOG_INF("Schedule: mode=%d local=%02d:%02d sleep=%ds",
	        mode, now.tm_hour, now.tm_min, sleep_s);

	boot_log_entry_t log_entry = {
		.epoch   = (int64_t)ntp_get_utc_now(),
		.sleep_s = sleep_s,
		.wakeup  = green_wake ? 1 : left_wake ? 2 : right_wake ? 3 : 0,
		.ntp_src = ntp_get_last_src(),
		.mode    = (uint8_t)mode,
	};
	boot_log_append(&log_entry);

	enter_deep_sleep(sleep_s);
	return 0;
}
```

## src/boot_log.c
```c
#include "boot_log.h"

#include <zephyr/settings/settings.h>
#include <zephyr/logging/log.h>
#include <string.h>
#include <time.h>

LOG_MODULE_REGISTER(boot_log, LOG_LEVEL_INF);

#define STORE_KEY "dash/bootlog"

typedef struct {
	uint8_t head;    /* index where the NEXT write goes   */
	uint8_t count;   /* 0..BOOT_LOG_ENTRIES valid entries */
	uint8_t _pad[2];
	boot_log_entry_t entries[BOOT_LOG_ENTRIES];
} boot_log_store_t;  /* 4 + 32*16 = 516 bytes */

static boot_log_store_t _store;
static bool _loaded;

static void load(void)
{
	if (_loaded) return;
	ssize_t n = settings_load_one(STORE_KEY, &_store, sizeof(_store));
	if (n != (ssize_t)sizeof(_store)) {
		memset(&_store, 0, sizeof(_store));
	}
	_loaded = true;
}

void boot_log_init(void)
{
	load();
}

/* Israel local time from UTC epoch (same approximation as ntp.c). */
static void epoch_to_local(int64_t epoch, int *year, int *mon, int *mday,
			    int *hour, int *min)
{
	time_t t = (time_t)epoch;
	struct tm u;
	gmtime_r(&t, &u);
	int m = u.tm_mon + 1;
	int off = 2;
	if ((m >= 4 && m <= 9) ||
	    (m == 3 && u.tm_mday >= 25) ||
	    (m == 10 && u.tm_mday < 26)) {
		off = 3;
	}
	t += off * 3600;
	struct tm l;
	gmtime_r(&t, &l);
	*year  = l.tm_year + 1900;
	*mon   = l.tm_mon  + 1;
	*mday  = l.tm_mday;
	*hour  = l.tm_hour;
	*min   = l.tm_min;
}

void boot_log_dump(void)
{
	load();
	if (_store.count == 0) {
		LOG_INF("boot_log: empty");
		return;
	}

	static const char *wake_s[] = {"timer", "green", "left ", "right"};
	static const char *ntp_s[]  = {"sync    ", "fallback", "none    "};
	static const char *mode_s[] = {"active  ", "ntp_sync", "inactive"};

	LOG_INF("=== boot_log: %u entries (oldest first) ===", _store.count);

	uint8_t start = (_store.head + BOOT_LOG_ENTRIES - _store.count)
	                % BOOT_LOG_ENTRIES;
	for (uint8_t i = 0; i < _store.count; i++) {
		uint8_t idx = (start + i) % BOOT_LOG_ENTRIES;
		const boot_log_entry_t *e = &_store.entries[idx];
		int y, mo, d, h, mi;
		epoch_to_local(e->epoch, &y, &mo, &d, &h, &mi);
		LOG_INF("[%02u] %04d-%02d-%02d %02d:%02d  wake=%s  ntp=%s  mode=%s  sleep=%ds",
			i, y, mo, d, h, mi,
			wake_s[e->wakeup  < 4 ? e->wakeup  : 0],
			ntp_s [e->ntp_src < 3 ? e->ntp_src : 0],
			mode_s[e->mode    < 3 ? e->mode    : 0],
			e->sleep_s);
	}
	LOG_INF("==========================================");
}

void boot_log_append(const boot_log_entry_t *e)
{
	load();
	_store.entries[_store.head] = *e;
	_store.head = (_store.head + 1) % BOOT_LOG_ENTRIES;
	if (_store.count < BOOT_LOG_ENTRIES) {
		_store.count++;
	}
	settings_save_one(STORE_KEY, &_store, sizeof(_store));
}
```

## src/boot_log.h
```c
#pragma once
#include <stdint.h>

#define BOOT_LOG_ENTRIES 64

/* NTP result codes — also returned by ntp_get_last_src() */
#define NTP_SRC_SYNCED   0   /* fresh SNTP response */
#define NTP_SRC_FALLBACK 1   /* SNTP failed, used stored epoch */
#define NTP_SRC_NONE     2   /* SNTP failed, no stored epoch */

typedef struct {
	int64_t epoch;    /* UTC seconds at this boot         */
	int32_t sleep_s;  /* sleep duration scheduled          */
	uint8_t wakeup;   /* 0=timer 1=green 2=left 3=right   */
	uint8_t ntp_src;  /* NTP_SRC_*                         */
	uint8_t mode;     /* schedule_mode_t 0=active 1=ntp_sync 2=inactive */
	uint8_t _pad;
} boot_log_entry_t;   /* 16 bytes */

/** Load ring buffer from NVS. Call once after nvs_store_init(). */
void boot_log_init(void);

/** Dump all stored entries to the serial log. */
void boot_log_dump(void);

/** Append one entry, overwriting the oldest when full, then persist to NVS. */
void boot_log_append(const boot_log_entry_t *e);
```

## src/button.c
```c
#include "button.h"
#include "config.h"

#include <zephyr/kernel.h>
#include <zephyr/drivers/gpio.h>
#include <zephyr/logging/log.h>
#include <esp_sleep.h>

LOG_MODULE_REGISTER(button, LOG_LEVEL_INF);

/* Board DTS aliases: sw0=GPIO3 (green), sw1=GPIO4 (left), sw2=GPIO5 (right) */
static const struct gpio_dt_spec btn_green =
	GPIO_DT_SPEC_GET(DT_ALIAS(sw0), gpios);
static const struct gpio_dt_spec btn_left =
	GPIO_DT_SPEC_GET(DT_ALIAS(sw1), gpios);
static const struct gpio_dt_spec btn_right =
	GPIO_DT_SPEC_GET(DT_ALIAS(sw2), gpios);

/* Runtime interrupt state */
static K_SEM_DEFINE(btn_sem, 0, 1);
static volatile button_mask_t _last_pressed = BUTTON_NONE;
static int64_t _last_event_ms = 0;
#define DEBOUNCE_MS 50

static struct gpio_callback _btn_cb;

static void btn_isr(const struct device *dev, struct gpio_callback *cb,
                    uint32_t pins)
{
	int64_t now = k_uptime_get();
	if ((now - _last_event_ms) < DEBOUNCE_MS) {
		return;
	}
	_last_event_ms = now;

	if (pins & BIT(BUTTON_GREEN_PIN)) {
		_last_pressed = BUTTON_GREEN;
	} else if (pins & BIT(BUTTON_LEFT_PIN)) {
		_last_pressed = BUTTON_LEFT;
	} else if (pins & BIT(BUTTON_RIGHT_PIN)) {
		_last_pressed = BUTTON_RIGHT;
	}
	k_sem_give(&btn_sem);
}

int button_init(void)
{
	const struct gpio_dt_spec *btns[] = {&btn_green, &btn_left, &btn_right};
	const char *names[] = {"green", "left", "right"};

	for (int i = 0; i < 3; i++) {
		if (!gpio_is_ready_dt(btns[i])) {
			LOG_ERR("Button %s GPIO not ready", names[i]);
			return -ENODEV;
		}
		int ret = gpio_pin_configure_dt(btns[i], GPIO_INPUT);
		if (ret) {
			LOG_ERR("Button %s configure failed: %d", names[i], ret);
			return ret;
		}
	}

	/* Register all three button pins as EXT1 deep-sleep wakeup sources.
	 * Done via ESP-IDF directly — does not require CONFIG_PM_DEVICE. */
	uint64_t wake_mask = BIT64(BUTTON_GREEN_PIN) |
	                     BIT64(BUTTON_LEFT_PIN)  |
	                     BIT64(BUTTON_RIGHT_PIN);
	esp_sleep_enable_ext1_wakeup(wake_mask, ESP_EXT1_WAKEUP_ANY_LOW);

	LOG_INF("Buttons initialised (green=GPIO%d, left=GPIO%d, right=GPIO%d)",
	        BUTTON_GREEN_PIN, BUTTON_LEFT_PIN, BUTTON_RIGHT_PIN);
	return 0;
}

button_mask_t button_get_wakeup_source(void)
{
	uint32_t causes = esp_sleep_get_wakeup_causes();
	if (!(causes & BIT(ESP_SLEEP_WAKEUP_EXT1))) {
		return BUTTON_NONE;
	}

	uint64_t pins = esp_sleep_get_ext1_wakeup_status();
	button_mask_t result = BUTTON_NONE;

	if (pins & BIT64(BUTTON_GREEN_PIN)) result |= BUTTON_GREEN;
	if (pins & BIT64(BUTTON_LEFT_PIN))  result |= BUTTON_LEFT;
	if (pins & BIT64(BUTTON_RIGHT_PIN)) result |= BUTTON_RIGHT;

	return result;
}

void button_enable_runtime_irq(void)
{
	const struct gpio_dt_spec *btns[] = {&btn_green, &btn_left, &btn_right};

	/* Switch from wakeup mode to standard falling-edge runtime interrupts */
	for (int i = 0; i < 3; i++) {
		gpio_pin_interrupt_configure_dt(btns[i], GPIO_INT_EDGE_FALLING);
	}

	uint32_t pin_mask = BIT(BUTTON_GREEN_PIN) | BIT(BUTTON_LEFT_PIN) |
	                    BIT(BUTTON_RIGHT_PIN);
	gpio_init_callback(&_btn_cb, btn_isr, pin_mask);
	gpio_add_callback(btn_green.port, &_btn_cb);

	k_sem_reset(&btn_sem);
	_last_event_ms = 0;
}

button_mask_t button_wait_any(int32_t timeout_ms)
{
	k_timeout_t to = (timeout_ms <= 0) ? K_FOREVER : K_MSEC(timeout_ms);
	_last_pressed = BUTTON_NONE;

	if (k_sem_take(&btn_sem, to) == 0) {
		return _last_pressed;
	}
	return BUTTON_NONE;
}
```

## src/button.h
```c
#pragma once
#include <stdint.h>

typedef enum {
	BUTTON_NONE  = 0,
	BUTTON_GREEN = (1 << 0),
	BUTTON_LEFT  = (1 << 1),
	BUTTON_RIGHT = (1 << 2),
} button_mask_t;

/**
 * Configure GPIO3/4/5 as inputs and wakeup sources for deep sleep.
 * Call once at boot before pm_device_wakeup_enable().
 */
int button_init(void);

/**
 * After deep sleep wakeup, return which button(s) caused the wakeup.
 * Uses esp_sleep_get_ext1_wakeup_status() to read the GPIO pin bitmask.
 * Returns BUTTON_NONE if wakeup was timer-triggered (not GPIO).
 */
button_mask_t button_get_wakeup_source(void);

/**
 * Switch to runtime edge-falling interrupts for use while fully awake
 * (e.g. during screensaver). Must be called before button_wait_any().
 */
void button_enable_runtime_irq(void);

/**
 * Block until any button is pressed (runtime mode only).
 * @param timeout_ms  Max wait in ms; pass 0 to wait indefinitely.
 * Returns BUTTON_NONE on timeout.
 */
button_mask_t button_wait_any(int32_t timeout_ms);
```

## src/config.h
```c
#pragma once

/* ── Wi-Fi ─────────────────────────────────────────────────── */
#define WIFI_SSID            "Eli"
#define WIFI_PASSWORD        "1020304050"
#define WIFI_RETRY_MAX       5
#define WIFI_TIMEOUT_MS      15000

/* ── Server ─────────────────────────────────────────────────── */
/* Set SERVER_HOST to the Arch Linux machine's LAN IP           */
#define SERVER_HOST          "10.100.102.216"
#define SERVER_PORT          8080
#define SERVER_PATH          "/display.png"

/* ── NTP ────────────────────────────────────────────────────── */
#define NTP_SERVER           "il.pool.ntp.org"
#define TZ_POSIX_STRING      "IST-2IDT,M3.4.4/26,M10.5.0"

/* ── Active windows (24-hour local time) ───────────────────── */
#define MORNING_START_H      5
#define MORNING_START_M      45
#define MORNING_END_H        8
#define MORNING_END_M        0
#define EVENING_START_H      18
#define EVENING_START_M      0
#define EVENING_END_H        22
#define EVENING_END_M        0

/* ── Daily NTP sync time (no screen refresh) ────────────────── */
#define NTP_SYNC_H           0
#define NTP_SYNC_M           0

/* ── Refresh policy ─────────────────────────────────────────── */
#define MAX_PARTIAL_BEFORE_FULL   5
#define POLL_INTERVAL_ACTIVE_S    60
#define POLL_INTERVAL_INACTIVE_S  1800

/* ── GPIO ───────────────────────────────────────────────────── */
#define BUTTON_GREEN_PIN     3
#define BUTTON_LEFT_PIN      4
#define BUTTON_RIGHT_PIN     5
#define LED_PIN              6   /* active LOW */
#define BUZZER_PIN           45

/* ── Display geometry ───────────────────────────────────────── */
#define DISPLAY_WIDTH        800
#define DISPLAY_HEIGHT       480
#define FB_PLANE_SIZE        (DISPLAY_WIDTH * DISPLAY_HEIGHT / 8)  /* 48000 bytes */
#define PNG_BUF_SIZE         (512 * 1024)

/* ── Screensaver ─────────────────────────────────────────────── */
#define SCREENSAVER_CYCLE_MS    30000   /* auto-advance every 30 s */
#define SCREENSAVER_ACTIVE_MS   300000  /* exit after 5 min */

/* ── ePaper SPI (hardware fixed — do not change) ────────────── */
#define EPAPER_CLK_PIN       7
#define EPAPER_MOSI_PIN      9
#define EPAPER_CS_PIN        10
#define EPAPER_DC_PIN        8
#define EPAPER_RST_PIN       47
#define EPAPER_BUSY_PIN      48
```

## src/epaper.c
```c
/*
 * ePaper driver interface for GDEY075T7 via UC8179 controller.
 *
 * This file wraps the Zephyr display subsystem driver.
 * The UC8179 driver is expected to be provided either by the board's
 * Zephyr BSP or vendored from the ZEReader project.
 *
 * Framebuffer format: 1 bit per pixel, packed, MSB first.
 * Display resolution: 800 × 480 pixels.
 */
#include "epaper.h"
#include "config.h"

#include <zephyr/kernel.h>
#include <zephyr/device.h>
#include <zephyr/drivers/display.h>
#include <zephyr/drivers/mipi_dbi.h>
#include <zephyr/drivers/gpio.h>
#include <zephyr/logging/log.h>
#include <string.h>

LOG_MODULE_REGISTER(epaper, LOG_LEVEL_INF);

#define DISPLAY_WIDTH   800
#define DISPLAY_HEIGHT  480
#define FB_BYTES        (DISPLAY_WIDTH * DISPLAY_HEIGHT / 8)

static const struct device *display_dev;
static const struct device *mipi_dev;

/* MIPI DBI SPI driver overrides .cs from DTS; frequency matches mipi-max-frequency */
static const struct mipi_dbi_config dbi_cfg = {
	.mode = MIPI_DBI_MODE_SPI_4WIRE,
	.config = {
		.frequency = 4000000,
		.operation = SPI_OP_MODE_MASTER | SPI_WORD_SET(8),
	},
};

/* BUSY pin — active-low, already configured as input by the UC81xx driver */
static const struct gpio_dt_spec busy_gpio =
	GPIO_DT_SPEC_GET(DT_CHOSEN(zephyr_display), busy_gpios);

int epaper_init(void)
{
	display_dev = DEVICE_DT_GET(DT_CHOSEN(zephyr_display));
	if (!device_is_ready(display_dev)) {
		LOG_ERR("Display device not ready");
		return -ENODEV;
	}
	display_set_pixel_format(display_dev, PIXEL_FORMAT_MONO10);

	/* DT_PARENT of epd_uc8179 = the mipi_dbi_epd controller */
	mipi_dev = DEVICE_DT_GET(DT_PARENT(DT_CHOSEN(zephyr_display)));
	if (!device_is_ready(mipi_dev)) {
		LOG_ERR("MIPI DBI device not ready");
		return -ENODEV;
	}

	LOG_INF("ePaper display initialised");
	return 0;
}

int epaper_full_refresh(const uint8_t *fb, size_t fb_len)
{
	if (!display_dev) return -ENODEV;

	struct display_buffer_descriptor desc = {
		.buf_size = fb_len,
		.width    = DISPLAY_WIDTH,
		.height   = DISPLAY_HEIGHT,
		.pitch    = DISPLAY_WIDTH,
	};

	/* blanking_on → write to back-buffer (DTM1) → blanking_off triggers full EPD refresh */
	display_blanking_on(display_dev);

	int ret = display_write(display_dev, 0, 0, &desc, fb);
	if (ret) {
		LOG_ERR("display_write failed: %d", ret);
		return ret;
	}

	/* PON → DRF → POF; leaves blanking_on=false for subsequent fast writes */
	ret = display_blanking_off(display_dev);
	if (ret) {
		LOG_ERR("blanking_off failed: %d", ret);
		return ret;
	}

	LOG_INF("Full refresh complete");
	return 0;
}

int epaper_fast_refresh(const uint8_t *fb, size_t fb_len)
{
	if (!display_dev) return -ENODEV;

	/* With blanking_on=false the driver writes to DTM2 and auto-triggers
	 * update_display() at the end — this is the fast/partial waveform path. */
	struct display_buffer_descriptor desc = {
		.buf_size = fb_len,
		.width    = DISPLAY_WIDTH,
		.height   = DISPLAY_HEIGHT,
		.pitch    = DISPLAY_WIDTH,
	};

	int ret = display_write(display_dev, 0, 0, &desc, fb);
	if (ret) {
		LOG_ERR("fast refresh failed: %d", ret);
	}
	LOG_INF("Fast refresh complete");
	return ret;
}

int epaper_partial_refresh(const uint8_t *fb, int x, int y, int w, int h)
{
	if (!display_dev) return -ENODEV;

	size_t region_bytes = (size_t)(w * h / 8);
	/* Build a sub-buffer for the region */
	static uint8_t region_buf[DISPLAY_WIDTH * 40 / 8]; /* max 40 rows at a time */
	if (region_bytes > sizeof(region_buf)) {
		LOG_WRN("Partial region too large — falling back to full refresh");
		return epaper_full_refresh(fb, FB_BYTES);
	}

	/* Extract rows from full framebuffer */
	int row_bytes = DISPLAY_WIDTH / 8;
	for (int row = 0; row < h; row++) {
		int src_byte = (y + row) * row_bytes + x / 8;
		memcpy(region_buf + row * (w / 8), fb + src_byte, w / 8);
	}

	struct display_buffer_descriptor desc = {
		.buf_size = region_bytes,
		.width    = w,
		.height   = h,
		.pitch    = w,
	};

	int ret = display_write(display_dev, x, y, &desc, region_buf);
	if (ret) {
		LOG_ERR("Partial refresh failed: %d", ret);
	}
	return ret;
}

void epaper_power_off(void)
{
	if (display_dev) {
		display_blanking_on(display_dev);
	}
}

void epaper_show_error(const char *msg)
{
	/* Minimal error display — white background, message in top-left.
	 * A proper implementation would render text using a bitmap font.
	 * For now, log only; the display retains its last image. */
	LOG_ERR("ePaper error screen: %s", msg);
}

/* --- 4-gray helpers ---------------------------------------------------- */

/* Generous ceiling for a single BUSY assertion. Full 4-gray DRF can take
 * multiple seconds; this only exists to catch a panel that never releases
 * BUSY (electrical glitch, brownout during PON, bad waveform) so the boot
 * cycle can fail and retry instead of spinning forever. */
#define EPAPER_BUSY_TIMEOUT_MS 15000

static int epaper_4gray_busy_wait(void)
{
	/* gpio_pin_get_dt returns 1 = active = busy (active-low: low pin = busy) */
	int64_t start = k_uptime_get();
	while (gpio_pin_get_dt(&busy_gpio) > 0) {
		if (k_uptime_get() - start > EPAPER_BUSY_TIMEOUT_MS) {
			LOG_ERR("BUSY stuck low for over %d ms — panel unresponsive",
			        EPAPER_BUSY_TIMEOUT_MS);
			return -ETIMEDOUT;
		}
		k_msleep(5);
	}
	return 0;
}

static int epaper_4gray_cmd(uint8_t cmd, const uint8_t *data, size_t len)
{
	int ret = mipi_dbi_command_write(mipi_dev, &dbi_cfg, cmd, data, len);
	mipi_dbi_release(mipi_dev, &dbi_cfg);
	if (ret) {
		LOG_ERR("4gray cmd 0x%02x failed: %d", cmd, ret);
	}
	return ret;
}

/* --- 4-gray public API -------------------------------------------------- */

int epaper_4gray_init(void)
{
	if (!mipi_dev || !device_is_ready(mipi_dev)) {
		return -ENODEV;
	}

	static const uint8_t pwr[]  = {0x07, 0x07, 0x3F, 0x3F, 0x09};
	static const uint8_t btst[] = {0x27, 0x27, 0x18, 0x17};

	if (epaper_4gray_cmd(0x01, pwr,  sizeof(pwr)))   return -EIO;  /* PWR  */
	if (epaper_4gray_cmd(0x06, btst, sizeof(btst)))  return -EIO;  /* BTST */
	if (epaper_4gray_cmd(0x00, (uint8_t[]){0x1F}, 1)) return -EIO; /* PSR: KW, OTP */
	if (epaper_4gray_cmd(0x50, (uint8_t[]){0x10, 0x07}, 2)) return -EIO; /* CDI */

	if (epaper_4gray_cmd(0x04, NULL, 0)) return -EIO; /* PON */
	k_msleep(100);
	if (epaper_4gray_busy_wait()) return -ETIMEDOUT;

	if (epaper_4gray_cmd(0xE0, (uint8_t[]){0x02}, 1)) return -EIO; /* CCSET: TSFIX=1 */
	if (epaper_4gray_cmd(0xE5, (uint8_t[]){0x5F}, 1)) return -EIO; /* TSSET: 4-gray OTP table */

	LOG_INF("4-gray init complete");
	return 0;
}

int epaper_4gray_refresh(const uint8_t *dtm1, const uint8_t *dtm2, size_t plane_len)
{
	if (!mipi_dev) return -ENODEV;

	if (epaper_4gray_cmd(0x10, dtm1, plane_len)) return -EIO; /* DTM1 plane */
	if (epaper_4gray_cmd(0x13, dtm2, plane_len)) return -EIO; /* DTM2 plane */

	if (epaper_4gray_cmd(0x04, NULL, 0)) return -EIO; /* PON */
	if (epaper_4gray_busy_wait()) return -ETIMEDOUT;

	if (epaper_4gray_cmd(0x12, NULL, 0)) return -EIO; /* DRF */
	k_msleep(100);
	if (epaper_4gray_busy_wait()) return -ETIMEDOUT;

	if (epaper_4gray_cmd(0x02, NULL, 0)) return -EIO; /* POF */
	if (epaper_4gray_busy_wait()) return -ETIMEDOUT;

	LOG_INF("4-gray refresh complete");
	return 0;
}
```

## src/epaper.h
```c
#pragma once
#include <stdint.h>
#include <stddef.h>

/** Initialise ePaper display and SPI peripheral. */
int epaper_init(void);

/** Send a full-refresh (3s, flickers). */
int epaper_full_refresh(const uint8_t *fb, size_t fb_len);

/** Send a fast-refresh (~1.5s, single flash). */
int epaper_fast_refresh(const uint8_t *fb, size_t fb_len);

/**
 * Partial refresh — only redraws a rectangular region.
 * @param fb       Full framebuffer (800×480 packed 1-bit).
 * @param x, y     Top-left corner of region.
 * @param w, h     Width and height of region.
 */
int epaper_partial_refresh(const uint8_t *fb, int x, int y, int w, int h);

/** Power off the panel (keeps image). Call before PM sleep. */
void epaper_power_off(void);

/** Display a plain-text error message (uses built-in font). */
void epaper_show_error(const char *msg);

/** Initialize UC8179 for 4-gray (OTP waveform + TSSET trick). Call after epaper_init(). */
int epaper_4gray_init(void);

/** Full 4-gray refresh. dtm1/dtm2 are the two 48000-byte plane buffers. */
int epaper_4gray_refresh(const uint8_t *dtm1, const uint8_t *dtm2, size_t plane_len);
```

## src/http_fetch.c
```c
#include "http_fetch.h"
#include "config.h"

#include <zephyr/kernel.h>
#include <zephyr/net/http/client.h>
#include <zephyr/net/socket.h>
#include <zephyr/logging/log.h>
#include <string.h>
#include <stdio.h>

LOG_MODULE_REGISTER(http_fetch, LOG_LEVEL_INF);

static uint8_t  *_buf;
static size_t    _buf_size;
static size_t    _received;
static int       _status_code;
static char      _etag_buf[128];
static bool      _etag_found;

static int response_cb(struct http_response *rsp,
                       enum http_final_call final_data,
                       void *user_data)
{
	_status_code = rsp->http_status_code;

	if (!_etag_found && rsp->body_frag_start > rsp->recv_buf) {
		size_t header_len = rsp->body_frag_start - rsp->recv_buf;
		char *hdr = (char *)rsp->recv_buf;
		char *etag = NULL;

		for (size_t i = 0; i + 5 < header_len; i++) {
			if ((hdr[i]   == 'E' || hdr[i]   == 'e') &&
			    (hdr[i+1] == 'T' || hdr[i+1] == 't') &&
			    (hdr[i+2] == 'a' || hdr[i+2] == 'a') &&
			    (hdr[i+3] == 'g' || hdr[i+3] == 'g') &&
			     hdr[i+4] == ':') {
				etag = hdr + i + 5;
				break;
			}
		}
		if (etag) {
			while (*etag == ' ') etag++;
			size_t len = 0;
			while (etag[len] && etag[len] != '\r' && etag[len] != '\n') len++;
			if (len > 0 && len < sizeof(_etag_buf) - 1) {
				memcpy(_etag_buf, etag, len);
				_etag_buf[len] = '\0';
				_etag_found = true;
			}
		}
	}

	if (rsp->body_frag_len > 0 && _buf) {
		size_t to_copy = rsp->body_frag_len;
		if (_received + to_copy > _buf_size) {
			to_copy = _buf_size - _received;
			LOG_WRN("Response buffer full — truncating");
		}
		memcpy(_buf + _received, rsp->body_frag_start, to_copy);
		_received += to_copy;
	}

	return 0;
}

int http_fetch(const char *path,
               const char *etag_in,
               uint8_t *buf, size_t buf_size,
               size_t *bytes_out,
               char *etag_out)
{
	_buf         = buf;
	_buf_size    = buf_size;
	_received    = 0;
	_status_code = 0;
	_etag_found  = false;
	memset(_etag_buf, 0, sizeof(_etag_buf));

	char if_none_match_hdr[128] = "";
	const char *opt_hdrs[2] = {NULL, NULL};

	if (etag_in && etag_in[0]) {
		snprintf(if_none_match_hdr, sizeof(if_none_match_hdr),
		         "If-None-Match: %s\r\n", etag_in);
		opt_hdrs[0] = if_none_match_hdr;
	}

	struct zsock_addrinfo hints = {.ai_socktype = SOCK_STREAM};
	struct zsock_addrinfo *addr;
	char port_str[8];
	snprintf(port_str, sizeof(port_str), "%d", SERVER_PORT);

	int ret = zsock_getaddrinfo(SERVER_HOST, port_str, &hints, &addr);
	if (ret) {
		LOG_ERR("DNS lookup failed: %d", ret);
		return HTTP_FETCH_ERR;
	}

	int sock = zsock_socket(addr->ai_family, SOCK_STREAM, IPPROTO_TCP);
	if (sock < 0) {
		zsock_freeaddrinfo(addr);
		return HTTP_FETCH_ERR;
	}

	ret = zsock_connect(sock, addr->ai_addr, addr->ai_addrlen);
	zsock_freeaddrinfo(addr);
	if (ret) {
		LOG_ERR("TCP connect failed: %d", ret);
		zsock_close(sock);
		return HTTP_FETCH_ERR;
	}

	static uint8_t recv_buf[4096];
	struct http_request req = {
		.method           = HTTP_GET,
		.url              = path,
		.host             = SERVER_HOST,
		.protocol         = "HTTP/1.1",
		.response         = response_cb,
		.recv_buf         = recv_buf,
		.recv_buf_len     = sizeof(recv_buf),
		.optional_headers = (etag_in && etag_in[0]) ? opt_hdrs : NULL,
	};

	ret = http_client_req(sock, &req, 10000, NULL);
	zsock_close(sock);

	if (ret < 0) {
		LOG_ERR("HTTP request failed: %d", ret);
		return HTTP_FETCH_ERR;
	}

	LOG_INF("HTTP %d %s — %zu bytes", _status_code, path, _received);

	if (_status_code == 304) {
		return HTTP_FETCH_NOT_MODIFIED;
	}
	if (_status_code == 404) {
		return HTTP_FETCH_NOT_FOUND;
	}
	if (_status_code == 200) {
		if (bytes_out) {
			*bytes_out = _received;
		}
		if (etag_out && _etag_found) {
			strncpy(etag_out, _etag_buf, 63);
			etag_out[63] = '\0';
		}
		return HTTP_FETCH_OK;
	}

	LOG_ERR("Unexpected HTTP status %d", _status_code);
	return HTTP_FETCH_ERR;
}

int http_fetch_text(const char *path, char *buf, size_t buf_size, size_t *bytes_out)
{
	size_t n = 0;
	int ret = http_fetch(path, NULL, (uint8_t *)buf, buf_size - 1, &n, NULL);
	if (ret == HTTP_FETCH_OK) {
		buf[n] = '\0';
		if (bytes_out) {
			*bytes_out = n;
		}
	}
	return ret;
}
```

## src/http_fetch.h
```c
#pragma once
#include <stddef.h>
#include <stdint.h>

#define HTTP_FETCH_OK            0
#define HTTP_FETCH_NOT_MODIFIED  1
#define HTTP_FETCH_NOT_FOUND     2
#define HTTP_FETCH_ERR          -1

/**
 * Fetch a binary resource (PNG) from the server.
 *
 * @param path      URL path, e.g. "/display.png" or "/screensaver/0".
 * @param etag_in   ETag from previous fetch, or NULL to skip If-None-Match.
 * @param buf       Buffer for response body.
 * @param buf_size  Size of buf.
 * @param bytes_out Bytes written on HTTP_FETCH_OK.
 * @param etag_out  New ETag (at least 64 bytes), or NULL to discard.
 *
 * Returns HTTP_FETCH_OK, HTTP_FETCH_NOT_MODIFIED, HTTP_FETCH_NOT_FOUND, or HTTP_FETCH_ERR.
 */
int http_fetch(const char *path,
               const char *etag_in,
               uint8_t *buf, size_t buf_size,
               size_t *bytes_out,
               char *etag_out);

/**
 * Fetch a small text/JSON response into a stack buffer.
 * Null-terminates buf on success. Does not use ETag.
 */
int http_fetch_text(const char *path, char *buf, size_t buf_size, size_t *bytes_out);
```

## src/ntp.c
```c
#include "ntp.h"
#include "boot_log.h"
#include "config.h"
#include "nvs_store.h"

#include <zephyr/kernel.h>
#include <zephyr/net/sntp.h>
#include <zephyr/drivers/rtc.h>
#include <zephyr/logging/log.h>
#include <time.h>

LOG_MODULE_REGISTER(ntp_mgr, LOG_LEVEL_INF);

static time_t  _epoch_at_sync     = 0;
static int64_t _uptime_ms_at_sync = 0;
static uint8_t _last_ntp_src      = NTP_SRC_NONE;

/* UTC struct tm → epoch without TZ dependency */
static time_t utc_tm_to_epoch(const struct tm *t)
{
	static const int mdays[] = {0,31,59,90,120,151,181,212,243,273,304,334};
	int y    = t->tm_year + 1900;
	int leap = (y % 4 == 0) && (y % 100 != 0 || y % 400 == 0);
	long days = (long)(y - 1970) * 365
	            + (y - 1969) / 4 - (y - 1901) / 100 + (y - 1601) / 400
	            + mdays[t->tm_mon]
	            + (t->tm_mon > 1 ? leap : 0)
	            + t->tm_mday - 1;
	return (time_t)(days * 86400L
	                + t->tm_hour * 3600L
	                + t->tm_min  * 60L
	                + t->tm_sec);
}

static const struct device *rtc_dev(void)
{
	static const struct device *dev;
	if (!dev) {
		dev = DEVICE_DT_GET_ANY(nxp_pcf8563);
		if (!dev || !device_is_ready(dev)) {
			LOG_WRN("PCF8563 not ready");
			dev = NULL;
		}
	}
	return dev;
}

static void rtc_write_utc(time_t utc_epoch)
{
	const struct device *dev = rtc_dev();
	if (!dev) return;
	struct tm t;
	gmtime_r(&utc_epoch, &t);
	struct rtc_time rt = {
		.tm_sec  = t.tm_sec,  .tm_min  = t.tm_min,
		.tm_hour = t.tm_hour, .tm_mday = t.tm_mday,
		.tm_mon  = t.tm_mon,  .tm_year = t.tm_year,
		.tm_wday = t.tm_wday,
	};
	if (rtc_set_time(dev, &rt) != 0) {
		LOG_WRN("RTC set failed");
	}
}

static time_t rtc_read_utc_epoch(void)
{
	const struct device *dev = rtc_dev();
	if (!dev) return 0;
	struct rtc_time rt;
	if (rtc_get_time(dev, &rt) != 0) return 0;
	struct tm t = {
		.tm_sec  = rt.tm_sec,  .tm_min  = rt.tm_min,
		.tm_hour = rt.tm_hour, .tm_mday = rt.tm_mday,
		.tm_mon  = rt.tm_mon,  .tm_year = rt.tm_year,
	};
	return utc_tm_to_epoch(&t);
}

int ntp_sync(void)
{
	struct sntp_time t;
	int ret = sntp_simple(NTP_SERVER, 5000, &t);
	if (ret) {
		/* RTC keeps running during deep sleep — use it as primary fallback. */
		time_t rtc_epoch = rtc_read_utc_epoch();
		if (rtc_epoch > 1700000000) {   /* sanity: after Nov 2023 */
			_epoch_at_sync     = rtc_epoch;
			_uptime_ms_at_sync = k_uptime_get();
			_last_ntp_src      = NTP_SRC_FALLBACK;
			LOG_WRN("SNTP failed (%d) — using RTC epoch %lld", ret, (long long)rtc_epoch);
		} else {
			/* RTC not set yet — last resort: NVS snapshot */
			int64_t stored = 0;
			nvs_store_epoch_get(&stored);
			if (stored > 0) {
				_epoch_at_sync     = (time_t)stored;
				_uptime_ms_at_sync = 0;
				_last_ntp_src      = NTP_SRC_FALLBACK;
				LOG_WRN("SNTP failed (%d) — RTC unset, using NVS epoch %lld",
				        ret, (long long)stored);
			} else {
				_last_ntp_src = NTP_SRC_NONE;
				LOG_WRN("SNTP failed (%d) — no time source available", ret);
			}
		}
		return ret;
	}

	_epoch_at_sync     = (time_t)t.seconds;
	_uptime_ms_at_sync = k_uptime_get();
	_last_ntp_src      = NTP_SRC_SYNCED;
	rtc_write_utc((time_t)t.seconds);
	nvs_store_epoch_set((int64_t)t.seconds);
	LOG_INF("Clock synced: epoch=%lld (RTC updated)", (long long)_epoch_at_sync);
	return 0;
}

uint8_t ntp_get_last_src(void)
{
	return _last_ntp_src;
}

time_t ntp_get_utc_now(void)
{
	int64_t elapsed_ms = k_uptime_get() - _uptime_ms_at_sync;
	return _epoch_at_sync + (time_t)(elapsed_ms / 1000);
}

/*
 * Israel offset: UTC+2 (IST) in winter, UTC+3 (IDT) in summer.
 * DST starts last Friday of March at 02:00 local; ends last Sunday of
 * October at 02:00 local. We approximate with fixed month boundaries
 * (at most 7 days error during transition weeks — acceptable for a display).
 */
static int israel_offset_sec(const struct tm *utc)
{
	int m = utc->tm_mon + 1; /* 1-12 */

	if (m >= 4 && m <= 9) return 3 * 3600; /* April-September: IDT */
	if (m == 3) return (utc->tm_mday >= 25) ? 3 * 3600 : 2 * 3600;
	if (m == 10) return (utc->tm_mday < 26) ? 3 * 3600 : 2 * 3600;
	return 2 * 3600; /* November-February: IST */
}

struct tm ntp_get_local_time(void)
{
	time_t utc_epoch = ntp_get_utc_now();
	struct tm utc_tm;
	gmtime_r(&utc_epoch, &utc_tm);

	time_t local_epoch = utc_epoch + israel_offset_sec(&utc_tm);
	struct tm result;
	gmtime_r(&local_epoch, &result);
	return result;
}
```

## src/ntp.h
```c
#pragma once
#include <stdint.h>
#include <time.h>

/**
 * Sync system clock via SNTP (il.pool.ntp.org).
 * On failure logs a warning and continues with RTC estimate.
 * Returns 0 on success, negative errno on failure.
 */
int ntp_sync(void);

/** Current local time with DST-correct offset (uses POSIX TZ). */
struct tm ntp_get_local_time(void);

/** Raw UTC epoch seconds — for computing precise sleep durations. */
time_t ntp_get_utc_now(void);

/** NTP_SRC_* code describing the outcome of the last ntp_sync() call. */
uint8_t ntp_get_last_src(void);
```

## src/nvs_store.c
```c
#include "nvs_store.h"

#include <zephyr/settings/settings.h>
#include <zephyr/logging/log.h>
#include <string.h>

LOG_MODULE_REGISTER(nvs_store, LOG_LEVEL_INF);

#define KEY_ETAG   "dash/etag"
#define KEY_BUFIDX "dash/bufidx"
#define KEY_PCNT   "dash/partcnt"
#define KEY_SSLAST "dash/sslast"
#define KEY_EPOCH  "dash/epoch"

int nvs_store_init(void)
{
	int ret = settings_subsys_init();
	if (ret) {
		LOG_ERR("settings_subsys_init failed: %d", ret);
	}
	return ret;
}

int nvs_store_etag_get(char *out, size_t maxlen)
{
	ssize_t n = settings_load_one(KEY_ETAG, out, maxlen - 1);
	if (n < 0) {
		out[0] = '\0';
		return 0;
	}
	out[n] = '\0';
	return 0;
}

int nvs_store_etag_set(const char *etag)
{
	return settings_save_one(KEY_ETAG, etag, strlen(etag));
}

int nvs_store_buf_index_get(uint8_t *out)
{
	ssize_t n = settings_load_one(KEY_BUFIDX, out, sizeof(*out));
	if (n < 0) {
		*out = 0;
	}
	return 0;
}

int nvs_store_buf_index_set(uint8_t idx)
{
	return settings_save_one(KEY_BUFIDX, &idx, sizeof(idx));
}

int nvs_store_partial_count_get(uint8_t *out)
{
	ssize_t n = settings_load_one(KEY_PCNT, out, sizeof(*out));
	if (n < 0) {
		*out = 0;
	}
	return 0;
}

int nvs_store_partial_count_set(uint8_t count)
{
	return settings_save_one(KEY_PCNT, &count, sizeof(count));
}

int nvs_store_ss_last_get(uint8_t *out)
{
	ssize_t n = settings_load_one(KEY_SSLAST, out, sizeof(*out));
	if (n < 0) {
		*out = 0;
	}
	return 0;
}

int nvs_store_ss_last_set(uint8_t val)
{
	return settings_save_one(KEY_SSLAST, &val, sizeof(val));
}

int nvs_store_epoch_get(int64_t *out)
{
	ssize_t n = settings_load_one(KEY_EPOCH, out, sizeof(*out));
	if (n < 0) {
		*out = 0;
	}
	return 0;
}

int nvs_store_epoch_set(int64_t epoch)
{
	return settings_save_one(KEY_EPOCH, &epoch, sizeof(epoch));
}
```
